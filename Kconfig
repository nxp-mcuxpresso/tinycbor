## Kconfig
```kconfig
#
# Copyright 2024 NXP
#
# SPDX-License-Identifier: MIT
#

menuconfig MCUX_COMPONENT_middleware.tinycbor
    bool "tinycbor"
    default n
    help
        Concise Binary Object Representation (CBOR) Library
```
